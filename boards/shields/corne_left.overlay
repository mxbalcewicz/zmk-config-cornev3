/ {
    zephyr,led-strip {
        compatible = "zmk,ws2812-strip";
        label = "RGB Underglow";

        gpios = <&gpio1 5 GPIO_ACTIVE_HIGH>; // P1.05 for nice!nano v2
        chain-length = <27>;                // Change if different
        color-order = "GRB";

        status = "okay";
    };
};